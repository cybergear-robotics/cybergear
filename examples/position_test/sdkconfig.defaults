## examples/position_test/sdkconfig.defaults
```kconfig
CONFIG_ESP_MAIN_TASK_STACK_SIZE=3000
CONFIG_ESP_TASK_WDT=n
CONFIG_CYBERGEAR_CAN_TX=13
CONFIG_CYBERGEAR_CAN_RX=14
```

## test/Kconfig.projbuild
```kconfig
menu "CyberGear Hardware Tests"

    config CYBERGEAR_CAN_TX
        int "CAN TX"
        default 13

    config CYBERGEAR_CAN_RX
        int "CAN RX"
        default 14

    config CYBERGEAR_MASTER_CAN_ID
        int "Master CAN ID"
        default 0

    config CYBERGEAR_MOTOR_CAN_ID
        int "CyberGear CAN ID"
        default 1

    config CYBERGEAR_RESTORE_MOTOR_CAN_ID
        int "Motor CAN ID after test"
        default 1

endmenu
```
